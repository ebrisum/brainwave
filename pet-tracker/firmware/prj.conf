## CMakeLists.txt
```
#
# Pet tracker firmware - nRF Connect SDK v3.4.x (Zephyr 4.4)
#
cmake_minimum_required(VERSION 3.20.0)

find_package(Zephyr REQUIRED HINTS $ENV{ZEPHYR_BASE})
project(pet_tracker)

target_sources(app PRIVATE
  src/main.c
  src/modem.c
  src/location.c
  src/cloud.c
  src/battery.c
  src/motion.c
  src/fota.c
  src/policy.c
)
```

## Kconfig
```
#
# Pet tracker application configuration
#
menu "Pet tracker"

config TRACKER_MQTT_BROKER_HOSTNAME
	string "MQTT broker hostname"
	default "mqtt.tracker.example.eu"
	help
	  Hostname of the MQTTS broker (AWS IoT Core ATS endpoint, HiveMQ,
	  EMQX, ...). Also used for TLS SNI and server hostname verification.

config TRACKER_MQTT_BROKER_PORT
	int "MQTT broker port"
	default 8883

config TRACKER_SEC_TAG
	int "Modem security tag holding CA, client certificate and private key"
	default 201
	help
	  Credentials are stored in the modem's protected key storage and are
	  never readable by the application core. The private key should be
	  generated inside the modem (AT%KEYGEN) during manufacturing.

config TRACKER_TLS_ECDSA_ONLY
	bool "Restrict TLS to ECDHE-ECDSA cipher suites"
	default y
	help
	  Forward secrecy with P-256 certificates only. The broker must present
	  an ECC server certificate (AWS IoT: Amazon Root CA 3).

config TRACKER_MQTT_KEEPALIVE_S
	int "MQTT keep-alive (seconds)"
	default 1200
	help
	  Long enough that the TCP/TLS session survives the GNSS search between
	  an A-GNSS download and the telemetry publish without extra pings.

config TRACKER_MOVING_INTERVAL_S
	int "Report interval while moving (seconds)"
	default 900
	range 60 86400

config TRACKER_STATIONARY_INTERVAL_S
	int "Heartbeat interval while stationary (seconds)"
	default 14400
	range 900 86400
	help
	  A resting pet costs no GNSS (the accelerometer says it hasn't moved),
	  so this is a ~0.04 mAh check-in. Keep it below the backend's
	  "tracker silent" alert for our collars (5 h, devices.silent_after_s).

config TRACKER_GNSS_TIMEOUT_S
	int "GNSS fix timeout (seconds)"
	default 90
	range 30 600
	help
	  Upper bound on GNSS on-time per report. With fresh A-GNSS data a fix
	  typically takes 2-15 s outdoors; the timeout caps the cost of
	  indoor / no-sky situations.

config TRACKER_AGNSS_WAIT_S
	int "Max wait for A-GNSS assistance data (seconds)"
	default 20

config TRACKER_GNSS_NOSKY_S
	int "Give up GNSS early without sky (seconds, 0 = never)"
	default 15
	range 0 120
	help
	  If after this many seconds of searching fewer than 3 satellites are
	  received at TRACKER_GNSS_NOSKY_CN0 or better, the pet is indoors (or
	  under a car): stop instead of burning the whole GNSS timeout. Outdoors
	  with A-GNSS a fix usually comes in 2-15 s, so a real fix is not lost.

config TRACKER_GNSS_NOSKY_CN0
	int "Weakest satellite signal that still counts (dB-Hz)"
	default 25
	range 15 40

config TRACKER_HOME_BATCH
	int "At home, upload positions in groups of"
	default 4
	range 1 8
	help
	  With home zones from the backend, positions inside a zone wait and go
	  up together. Leaving or entering a zone, positions outside, lost mode
	  and the first contact after boot are always uploaded at once.

config TRACKER_HOME_MAX_AGE_S
	int "At home, upload at least every (seconds)"
	default 3600

config TRACKER_CONTACT_MAX_S
	int "Contact the backend at least every (seconds)"
	default 7200
	help
	  Even with nothing new: a heartbeat with the battery level, a chance to
	  receive settings, and it keeps the backend's "tracker silent" alert
	  (after 3 h) quiet. Lost mode and settings changes therefore reach a
	  collar resting at home within this time at worst.

config TRACKER_STILL_VERIFY_S
	int "Check the position of a resting pet every (seconds, 0 = never)"
	default 28800
	range 0 86400
	help
	  "Resting" comes from the accelerometer. In case it misses movement
	  (very gentle walking, a smooth car ride, a faulty sensor), a resting
	  collar still takes a fix this often. If the pet turns out to be far
	  from its last fix, the collar switches to moving at once and uploads.
	  Costs ~0.1-0.2 mAh per check.

config TRACKER_COVERAGE_AWARE
	bool "Hold routine uploads while the modem predicts an expensive session"
	default y
	help
	  Uses the modem's connection evaluation (energy estimate). In very poor
	  coverage a session can cost several times the normal energy; routine
	  positions then wait for better coverage, within TRACKER_CONTACT_MAX_S.

config TRACKER_BACKLOG_SIZE
	int "Number of fixes buffered while out of coverage"
	default 32
	range 1 256

config TRACKER_WDT_TIMEOUT_S
	int "Watchdog timeout (seconds)"
	default 900
	help
	  Must exceed the worst-case report cycle (LTE search + A-GNSS + GNSS
	  timeout + MQTT session).

module = TRACKER
module-str = Pet tracker
source "subsys/logging/Kconfig.template.log_config"

endmenu

source "Kconfig.zephyr"
```

## prj.conf
```kconfig
#
# Pet tracker - PRODUCTION configuration (secure & low-power by default).
# For development add:  -DEXTRA_CONF_FILE=overlay-debug.conf
#

# =============================================================================
# LTE-M / NB-IoT link (lte_lc applies all of this at modem init)
# =============================================================================
CONFIG_NRF_MODEM_LIB=y
CONFIG_NETWORKING=y
CONFIG_NET_SOCKETS=y
CONFIG_NET_SOCKETS_OFFLOAD=y
CONFIG_NET_NATIVE=n
CONFIG_LTE_LINK_CONTROL=y

# LTE-M first: connected-mode mobility (a moving pet), lower latency and far
# shorter radio-on time per TLS exchange than NB-IoT. NB-IoT as fallback for
# deep-indoor coverage. GPS enabled in the system mode.
CONFIG_LTE_NETWORK_MODE_LTE_M_NBIOT_GPS=y
CONFIG_LTE_MODE_PREFERENCE_LTE_M=y

# 1NCE APN, IPv4 only (IPv6 doubles PDN setup signalling for no benefit here)
CONFIG_LTE_LC_PDN_MODULE=y
CONFIG_LTE_LC_PDN_DEFAULTS_OVERRIDE=y
CONFIG_LTE_LC_PDN_DEFAULT_APN="iot.1nce.net"
CONFIG_LTE_LC_PDN_DEFAULT_FAM_IPV4=y

# --- Power Saving Mode -------------------------------------------------------
# Requested values (3GPP TS 24.008); the network may grant different ones -
# the granted values are logged on LTE_LC_EVT_PSM_UPDATE.
#   Periodic TAU (T3412ext) "001 01100" = 12 x 1 h  = 12 h
#   Active time  (T3324)    "000 00011" =  3 x 2 s  =  6 s
# The long TAU keeps "keep-alive" signalling to two per day; the device is
# always the initiator (reports), so it never needs to be pageable for long.
CONFIG_LTE_LC_PSM_MODULE=y
CONFIG_LTE_PSM_REQ=y
CONFIG_LTE_PSM_REQ_FORMAT_STRING=y
CONFIG_LTE_PSM_REQ_RPTAU="00101100"
CONFIG_LTE_PSM_REQ_RAT="00000011"

# --- eDRX: only used in "lost mode" (cloud command, PSM off) ----------------
#   LTE-M eDRX "0101" = 81.92 s paging cycle; PTW "0000" = 1.28 s
CONFIG_LTE_LC_EDRX_MODULE=y
CONFIG_LTE_EDRX_REQ=n
CONFIG_LTE_EDRX_REQ_VALUE_LTE_M="0101"
CONFIG_LTE_PTW_VALUE_LTE_M="0000"

# --- Release Assistance Indication: skip the RRC inactivity tail -------------
CONFIG_LTE_LC_RAI_MODULE=y
CONFIG_LTE_RAI_REQ=y

CONFIG_LTE_LC_MODEM_SLEEP_MODULE=y
# Energy estimate before a session (coverage-aware uploads)
CONFIG_LTE_LC_CONN_EVAL_MODULE=y
CONFIG_LTE_NETWORK_TIMEOUT=600

# Battery voltage via %XVBAT
CONFIG_AT_MONITOR=y
CONFIG_MODEM_BATTERY=y

# =============================================================================
# A-GNSS: assistance data is fetched by our backend and injected locally,
# so the device never talks to a third-party cloud directly.
# =============================================================================
CONFIG_MODEM_INFO=y
CONFIG_MODEM_INFO_ADD_NETWORK=y
CONFIG_NRF_CLOUD=y
CONFIG_NRF_CLOUD_MQTT=n
CONFIG_NRF_CLOUD_COAP=n
CONFIG_NRF_CLOUD_AGNSS=y

# =============================================================================
# MQTT over TLS (TLS runs inside the modem; credentials in modem key storage)
# =============================================================================
CONFIG_MQTT_LIB=y
CONFIG_MQTT_LIB_TLS=y
CONFIG_JSON_LIBRARY=y

# =============================================================================
# FOTA (signed + encrypted MCUboot images over HTTPS)
# =============================================================================
CONFIG_FLASH=y
CONFIG_FLASH_MAP=y
CONFIG_STREAM_FLASH=y
CONFIG_MCUBOOT_IMG_MANAGER=y
CONFIG_IMG_MANAGER=y
CONFIG_DFU_TARGET=y
CONFIG_DOWNLOADER=y
CONFIG_FOTA_DOWNLOAD=y

# =============================================================================
# Power: no UART, no logging, no console. An enabled UARTE alone draws
# ~0.6 mA - more than the whole PSM + accelerometer budget combined.
# =============================================================================
CONFIG_SERIAL=n
CONFIG_CONSOLE=n
CONFIG_UART_CONSOLE=n
CONFIG_LOG=n
CONFIG_PRINTK=n
CONFIG_TFM_LOG_LEVEL_SILENCE=y
CONFIG_PM_DEVICE=y

# =============================================================================
# Robustness & hardening
# =============================================================================
CONFIG_WATCHDOG=y
CONFIG_TASK_WDT=y
CONFIG_TASK_WDT_HW_FALLBACK=y
CONFIG_RESET_ON_FATAL_ERROR=y
CONFIG_HW_STACK_PROTECTION=y
CONFIG_STACK_CANARIES=y
CONFIG_REBOOT=y

# =============================================================================
# System
# =============================================================================
CONFIG_EVENTS=y
CONFIG_CBPRINTF_FP_SUPPORT=y
CONFIG_PICOLIBC_IO_FLOAT=y
CONFIG_MAIN_STACK_SIZE=6144
CONFIG_SYSTEM_WORKQUEUE_STACK_SIZE=2048
CONFIG_HEAP_MEM_POOL_SIZE=16384
```

## boards/thingy91_nrf9160_ns.conf
```kconfig
#
# Thingy:91 (nRF9160 + ADXL362): reference hardware for the motion logic.
#
# ADXL362 in linked + referenced mode with autosleep: one interrupt when
# motion starts, one after 5 min of stillness; ~270 nA while asleep.
#   ODR 12.5 Hz, +-2 g (1 mg/LSB)
#   activity:   >80 mg for 5 samples (~400 ms)
#   inactivity: <60 mg for 3750 samples (5 min)
#
# Tuned for cats: a stalking cat moves gently, so the activity threshold is
# low (dog trackers use ~150 mg); 400 ms filters single twitches in sleep.
# Missing a walk is worse than an extra fix after grooming; and a resting
# collar re-checks its position every 8 h (TRACKER_STILL_VERIFY_S) in case
# movement slips through. Tune both on real cats with the debug overlay.
#
CONFIG_SENSOR=y
CONFIG_ADXL362=y
CONFIG_ADXL362_TRIGGER_GLOBAL_THREAD=y
CONFIG_ADXL362_ACCEL_RANGE_2G=y
CONFIG_ADXL362_ACCEL_ODR_12_5=y
CONFIG_ADXL362_INTERRUPT_MODE=1
CONFIG_ADXL362_ABS_REF_MODE=1
CONFIG_ADXL362_ACTIVITY_THRESHOLD=80
CONFIG_ADXL362_ACTIVITY_TIME=5
CONFIG_ADXL362_INACTIVITY_THRESHOLD=60
CONFIG_ADXL362_INACTIVITY_TIME=3750
```

## src/main.c
```c
/*
 * Pet tracker - application state machine.
 *
 *            motion start                       still for N min
 *  STATIONARY ------------> MOVING ---------------------------> STATIONARY
 *  (4 h check-in, no GNSS)  (report every 15 min)
 *
 * Every report runs the same low-power sequence, with the power policy
 * (policy.c) deciding what is actually worth the energy:
 *   1. GNSS single fix while LTE sleeps in PSM - unless the pet hasn't moved
 *      since the last fix, or recent searches found no sky (backoff). A
 *      search without usable satellites stops after ~15 s, not 90 s. If the
 *      modem asks for assistance data, a short MQTT exchange fetches A-GNSS
 *      and RAI hands the radio straight back to GNSS.
 *   2. One MQTT/TLS session - unless the news can wait: positions inside a
 *      home zone are batched (4 fixes / 1 h), routine uploads wait out very
 *      poor coverage. Leaving or entering a zone, lost mode and positions
 *      away from home always go at once. The backlog goes up in batch
 *      messages; without a new fix a tiny heartbeat goes instead.
 *   3. RAI + DISCONNECT: modem returns to PSM (~3 uA), application core to
 *      System ON idle; nothing runs until a timer or the accelerometer fires.
 */
#include <stdio.h>
#include <zephyr/kernel.h>
#include <zephyr/logging/log.h>
#include <zephyr/sys/reboot.h>
#include <zephyr/task_wdt/task_wdt.h>

#include "battery.h"
#include "cloud.h"
#include "fota.h"
#include "location.h"
#include "modem.h"
#include "motion.h"
#include "tracker.h"

LOG_MODULE_REGISTER(tracker, CONFIG_TRACKER_LOG_LEVEL);

#define LOST_MODE_INTERVAL_S      60
#define MIN_REPORT_SPACING_MS     (2 * MSEC_PER_SEC * 60)
#define NETWORK_WAIT              K_SECONDS(60)
#define DOWNLINK_DRAIN_MS         1000

enum app_state {
	STATE_STATIONARY,
	STATE_MOVING,
};

enum app_evt {
	EVT_REPORT_DUE,
	EVT_MOTION_START,
	EVT_MOTION_STOP,
};

K_MSGQ_DEFINE(app_msgq, sizeof(enum app_evt), 8, 4);

static enum app_state state = STATE_MOVING;
static struct tracker_config config = {
	.moving_interval_s = CONFIG_TRACKER_MOVING_INTERVAL_S,
	.lost_mode = false,
	.night_mode = false,
	.night_start_utc_min = 19 * 60,
	.night_end_utc_min = 5 * 60,
	.night_interval_s = 300,
};
static char device_id[TRACKER_DEVICE_ID_LEN];
static int wdt_channel = -1;
static int64_t last_report_ms = INT64_MIN / 2;
static uint32_t fix_seq;

/* Power policy state (see policy.h). */
static struct gnss_backoff gnss_backoff;
static bool has_accelerometer;
static bool moved_since_fix = true;  /* nothing known after boot */
static bool have_fix;
static struct tracker_fix last_good_fix;
static int64_t last_good_fix_ms;
static bool missed_motion;           /* a check fix found the pet elsewhere */
static enum zone_place last_place = PLACE_UNKNOWN;
static bool contacted;               /* a session succeeded since boot */
static int64_t last_contact_ms;

static const struct upload_cfg upload_cfg = {
	.home_batch = CONFIG_TRACKER_HOME_BATCH,
	.home_max_age_ms = (int64_t)CONFIG_TRACKER_HOME_MAX_AGE_S * MSEC_PER_SEC,
	.contact_max_ms = (int64_t)CONFIG_TRACKER_CONTACT_MAX_S * MSEC_PER_SEC,
};

/* --------------------------------------------------------------------------
 * Store-and-forward backlog (RAM ring buffer; oldest entry dropped when full)
 * -------------------------------------------------------------------------- */
static struct tracker_fix backlog[CONFIG_TRACKER_BACKLOG_SIZE];
static int64_t backlog_queued_ms[CONFIG_TRACKER_BACKLOG_SIZE]; /* uptime when queued */
static size_t backlog_head;
static size_t backlog_count;

static void backlog_push(const struct tracker_fix *fix)
{
	size_t tail = (backlog_head + backlog_count) % ARRAY_SIZE(backlog);

	if (backlog_count == ARRAY_SIZE(backlog)) {
		backlog_head = (backlog_head + 1) % ARRAY_SIZE(backlog);
		backlog_count--;
	}

	backlog[tail] = *fix;
	backlog_queued_ms[tail] = k_uptime_get();
	backlog_count++;
}

static int64_t backlog_oldest_ms(void)
{
	return backlog_count ? backlog_queued_ms[backlog_head] : 0;
}

/* Copies up to max of the oldest fixes into out[] (the ring may wrap). */
static size_t backlog_take(struct tracker_fix *out, size_t max)
{
	size_t n = MIN(max, backlog_count);

	for (size_t i = 0; i < n; i++) {
		out[i] = backlog[(backlog_head + i) % ARRAY_SIZE(backlog)];
	}
	return n;
}

static void backlog_drop(size_t n)
{
	n = MIN(n, backlog_count);
	backlog_head = (backlog_head + n) % ARRAY_SIZE(backlog);
	backlog_count -= n;
}

/* --------------------------------------------------------------------------
 * Event sources
 * -------------------------------------------------------------------------- */
static void post(enum app_evt evt)
{
	if (k_msgq_put(&app_msgq, &evt, K_NO_WAIT)) {
		LOG_WRN("Event queue full, dropping %d", evt);
	}
}

static void report_timer_handler(struct k_timer *timer)
{
	ARG_UNUSED(timer);
	post(EVT_REPORT_DUE);
}

K_TIMER_DEFINE(report_timer, report_timer_handler, NULL);

static void motion_handler(bool moving)
{
	post(moving ? EVT_MOTION_START : EVT_MOTION_STOP);
}

/* UTC clock derived from the last GNSS fix (the app core has no RTC sync). */
static int64_t utc_base_s = -1;
static int64_t utc_base_uptime_ms;

static void utc_sync(int64_t utc_s)
{
	utc_base_s = utc_s;
	utc_base_uptime_ms = k_uptime_get();
}

static bool night_watch_active(void)
{
	int64_t now_s;
	uint16_t minute;

	if (!config.night_mode || utc_base_s < 0) {
		return false;
	}

	now_s = utc_base_s + (k_uptime_get() - utc_base_uptime_ms) / MSEC_PER_SEC;
	minute = (uint16_t)((now_s / 60) % 1440);

	if (config.night_start_utc_min > config.night_end_utc_min) {
		/* window wraps midnight, e.g. 19:00-05:00 UTC */
		return minute >= config.night_start_utc_min || minute < config.night_end_utc_min;
	}
	return minute >= config.night_start_utc_min && minute < config.night_end_utc_min;
}

/* Seconds until the night window opens or closes (UINT32_MAX if unknown). */
static uint32_t seconds_to_night_edge(void)
{
	int64_t now_s;
	uint32_t minute, edge, delta_min;

	if (!config.night_mode || utc_base_s < 0) {
		return UINT32_MAX;
	}

	now_s = utc_base_s + (k_uptime_get() - utc_base_uptime_ms) / MSEC_PER_SEC;
	minute = (uint32_t)((now_s / 60) % 1440);
	edge = night_watch_active() ? config.night_end_utc_min : config.night_start_utc_min;
	delta_min = (edge + 1440 - minute) % 1440;

	return MAX(delta_min, 1U) * 60U;
}

static bool scheduled_night;

static void reschedule(void)
{
	uint32_t period_s;
	uint32_t first_s;
	bool night = night_watch_active();

	scheduled_night = night;

	if (config.lost_mode) {
		period_s = LOST_MODE_INTERVAL_S;
	} else if (state == STATE_MOVING) {
		period_s = night ? MIN(config.night_interval_s, config.moving_interval_s)
				 : config.moving_interval_s;
	} else {
		/* Resting, day or night: the accelerometer wakes us the moment
		 * the pet moves, so only a check-in is due.
		 */
		period_s = CONFIG_TRACKER_STATIONARY_INTERVAL_S;
	}

	/* Wake up at the night-window edge even during a long sleep interval. */
	first_s = MIN(period_s, seconds_to_night_edge());
	k_timer_start(&report_timer, K_SECONDS(first_s), K_SECONDS(period_s));
	LOG_INF("Next report in %u s, then every %u s%s", first_s, period_s, night ? " (night watch)" : "");
}

/* --------------------------------------------------------------------------
 * Cloud downlinks (invoked from within cloud_* calls, i.e. this thread)
 * -------------------------------------------------------------------------- */
static void config_handler(const struct tracker_config *cfg)
{
	if (cfg->lost_mode != config.lost_mode) {
		(void)modem_lost_mode_set(cfg->lost_mode);
		policy_gnss_reset(&gnss_backoff); /* search every cycle again */
	}
	if (cfg->zone_count != config.zone_count) {
		LOG_INF("%u home zone(s)", cfg->zone_count);
	}

	config = *cfg;
	reschedule();
}

static void fota_handler(const char *host, const char *path)
{
	(void)fota_start(host, path);
}

static const struct cloud_handlers cloud_handlers = {
	.config = config_handler,
	.fota = fota_handler,
};

/* --------------------------------------------------------------------------
 * Report cycle
 * -------------------------------------------------------------------------- */
static enum gnss_result acquire_fix(enum zone_place *place)
{
	/* Hard upper bound in case the modem never reports back. */
	const int64_t deadline = k_uptime_get() +
		(CONFIG_TRACKER_GNSS_TIMEOUT_S + CONFIG_TRACKER_AGNSS_WAIT_S + 30) * MSEC_PER_SEC;
	struct tracker_fix fix = { 0 };

	*place = PLACE_UNKNOWN;

	if (location_fix_start(CONFIG_TRACKER_GNSS_TIMEOUT_S)) {
		return GNSS_RESULT_TIMEOUT;
	}

	while (true) {
		int64_t remaining = deadline - k_uptime_get();
		enum location_evt evt = location_wait(K_MSEC(MAX(remaining, 0)));

		switch (evt) {
		case LOCATION_EVT_FIX: {
			int batt = battery_percent_get();

			location_fix_get(&fix);
			utc_sync(fix.ts);
			fix.seq = fix_seq++;
			fix.batt_pct = batt < 0 ? 0 : (uint8_t)batt;
			backlog_push(&fix);
			(void)location_stop();

			/* A check while "resting" that finds the pet far away:
			 * the accelerometer missed the movement.
			 */
			if (have_fix && !moved_since_fix &&
			    policy_moved_far(last_good_fix.lat, last_good_fix.lng, last_good_fix.accuracy_m,
					     fix.lat, fix.lng, fix.accuracy_m)) {
				LOG_WRN("Moved while marked as resting: switching to moving");
				missed_motion = true;
			}
			last_good_fix = fix;
			last_good_fix_ms = k_uptime_get();
			have_fix = true;
			moved_since_fix = false;
			*place = policy_zone_place(config.zones, config.zone_count, fix.lat, fix.lng,
						   fix.accuracy_m);
			return GNSS_RESULT_FIX;
		}
		case LOCATION_EVT_AGNSS_NEEDED:
			/* Ephemerides are valid ~4 h, so this happens rarely when
			 * moving and roughly once per heartbeat when stationary.
			 */
			if (modem_is_registered()) {
				struct modem_cell_info cell = { 0 };

				(void)modem_cell_info_get(&cell);
				if (cloud_agnss_fetch(location_agnss_request(), &cell)) {
					LOG_WRN("A-GNSS fetch failed, continuing unassisted");
				}
				/* Free the shared radio for GNSS immediately. */
				cloud_radio_release();
				location_assistance_injected();
			}
			break;
		case LOCATION_EVT_NO_SKY:
			LOG_INF("No sky (indoors?), GNSS stopped early");
			(void)location_stop();
			return GNSS_RESULT_NO_SKY;
		case LOCATION_EVT_TIMEOUT:
		case LOCATION_EVT_NONE:
		default:
			LOG_WRN("No GNSS fix this cycle");
			(void)location_stop();
			return GNSS_RESULT_TIMEOUT;
		}
	}
}

/*
 * gnss_note: why this cycle has no new fix ("still", "no_sky", ...), or NULL
 * if it has one. With nothing to upload, a heartbeat carries it instead.
 */
static void cloud_session(const char *gnss_note)
{
	struct tracker_fix batch[CLOUD_BATCH_MAX];
	bool published = false;
	int err;

	if (modem_wait_registered(NETWORK_WAIT)) {
		LOG_WRN("No LTE coverage, %u fix(es) buffered", (unsigned int)backlog_count);
		return;
	}

	err = cloud_connect();
	if (err) {
		LOG_WRN("Cloud unreachable (%d), %u fix(es) buffered", err,
			(unsigned int)backlog_count);
		return;
	}

	while (backlog_count > 0) {
		size_t n = backlog_take(batch, ARRAY_SIZE(batch));

		/* One fix keeps the original message (also understood by older
		 * backends); several go as one batch: one PUBACK round trip.
		 */
		err = n == 1 ? cloud_publish_fix(&batch[0]) : cloud_publish_fixes(batch, n);
		if (err) {
			LOG_WRN("Publish failed: %d", err);
			break;
		}
		backlog_drop(n);
		published = true;
	}

	if (!published && gnss_note && backlog_count == 0) {
		int batt = battery_percent_get();

		published = cloud_publish_heartbeat(batt < 0 ? 0 : (uint8_t)batt, gnss_note) == 0;
	}

	if (published) {
		contacted = true;
		last_contact_ms = k_uptime_get();
		/* A fresh image has proven it can boot, attach and talk TLS. */
		fota_confirm_image();
	}

	/* Queued downlinks from the persistent session arrive right after
	 * CONNACK; give stragglers a moment, then hang up.
	 */
	(void)cloud_poll(DOWNLINK_DRAIN_MS);
	cloud_disconnect();
}

static bool is_routine(enum upload_reason reason)
{
	return reason == UPLOAD_OUTSIDE || reason == UPLOAD_NO_ZONES ||
	       reason == UPLOAD_BATCH_FULL || reason == UPLOAD_BATCH_AGE;
}

static void report(void)
{
	enum gnss_result result;
	enum zone_place place = PLACE_UNKNOWN;
	const char *gnss_note;
	enum upload_reason reason;
	struct upload_ctx ctx;
	int64_t now;

	if (fota_in_progress()) {
		return; /* the download owns the radio until it reboots */
	}

	now = k_uptime_get();
	last_report_ms = now;

	/* Without an accelerometer nothing says "hasn't moved": always look. */
	if (!has_accelerometer) {
		moved_since_fix = true;
	}

	if (policy_should_fix(&gnss_backoff, config.lost_mode, moved_since_fix, have_fix,
			      last_good_fix_ms, (int64_t)CONFIG_TRACKER_STILL_VERIFY_S * MSEC_PER_SEC, now)) {
		result = acquire_fix(&place);
		policy_gnss_result(&gnss_backoff, result, k_uptime_get());
		gnss_note = result == GNSS_RESULT_FIX ? NULL :
			    result == GNSS_RESULT_NO_SKY ? "no_sky" : "timeout";
	} else {
		gnss_note = (moved_since_fix || !have_fix) ? "skipped" : "still";
		LOG_INF("GNSS skipped (%s)", gnss_note);
	}
	task_wdt_feed(wdt_channel);

	if (missed_motion && state == STATE_STATIONARY) {
		state = STATE_MOVING;
		reschedule();
	}

	ctx = (struct upload_ctx){
		.lost_mode = config.lost_mode,
		.first_contact = !contacted,
		.missed_motion = missed_motion,
		.zones_known = config.zone_count > 0,
		.place = place,
		.prev_place = last_place,
		.backlog = backlog_count,
		.backlog_max = ARRAY_SIZE(backlog),
		.now_ms = k_uptime_get(),
		.oldest_unsent_ms = backlog_oldest_ms(),
		.last_contact_ms = last_contact_ms,
	};
	reason = policy_upload(&ctx, &upload_cfg);

	/* Only routine uploads may wait for better coverage, and the modem is
	 * only asked when that could change the decision.
	 */
	if (IS_ENABLED(CONFIG_TRACKER_COVERAGE_AWARE) && is_routine(reason) && modem_coverage_poor()) {
		ctx.coverage_poor = true;
		reason = policy_upload(&ctx, &upload_cfg);
	}

	if (place != PLACE_UNKNOWN) {
		last_place = place;
	}

	missed_motion = false;

	if (reason != UPLOAD_DEFER) {
		LOG_INF("Uploading (reason %d, %u fix(es))", reason, (unsigned int)backlog_count);
		cloud_session(gnss_note);
	} else {
		LOG_INF("Holding %u fix(es) for later", (unsigned int)backlog_count);
		cloud_disconnect(); /* in case an A-GNSS exchange opened a session */
	}

	/* Entering or leaving the night window changes the cadence. */
	if (night_watch_active() != scheduled_night) {
		reschedule();
	}
}

/* --------------------------------------------------------------------------
 * Main
 * -------------------------------------------------------------------------- */
static void watchdog_init(void)
{
	const struct device *hw_wdt = DEVICE_DT_GET_OR_NULL(DT_ALIAS(watchdog0));

	if (task_wdt_init(device_is_ready(hw_wdt) ? hw_wdt : NULL)) {
		LOG_ERR("Task watchdog init failed");
		return;
	}

	/* No callback: an expired channel resets the SoC. */
	wdt_channel = task_wdt_add(CONFIG_TRACKER_WDT_TIMEOUT_S * MSEC_PER_SEC, NULL, NULL);
}

int main(void)
{
	char imei[16];
	int err;

	watchdog_init();

	err = modem_init();
	if (err) {
		LOG_ERR("Modem init failed (%d), rebooting in 60 s", err);
		k_sleep(K_SECONDS(60));
		sys_reboot(SYS_REBOOT_COLD);
	}

	if (modem_imei_get(imei, sizeof(imei)) == 0) {
		snprintf(device_id, sizeof(device_id), "pt-%s", imei);
	}
	LOG_INF("Device %s", device_id);

	(void)location_init();
	(void)fota_init();
	(void)cloud_init(device_id, &cloud_handlers);

	has_accelerometer = motion_init(motion_handler) == 0;
	if (!has_accelerometer) {
		LOG_WRN("No accelerometer: fixed-interval reporting, a fix every cycle");
	}

	/* First fix right after boot, then on schedule. */
	post(EVT_REPORT_DUE);
	reschedule();

	while (true) {
		enum app_evt evt;

		/* Wake at least twice per watchdog period to prove liveness. */
		if (k_msgq_get(&app_msgq, &evt,
			       K_SECONDS(CONFIG_TRACKER_WDT_TIMEOUT_S / 2)) == 0) {
			switch (evt) {
			case EVT_MOTION_START:
				moved_since_fix = true;
				if (state == STATE_STATIONARY) {
					LOG_INF("Moving");
					state = STATE_MOVING;
					/* A new outing: forget earlier "no sky" misses. */
					policy_gnss_reset(&gnss_backoff);
					reschedule();
					/* Owner sees the departure promptly, but
					 * jitter (a dog turning over) is rate-limited.
					 */
					if (k_uptime_get() - last_report_ms > MIN_REPORT_SPACING_MS) {
						report();
					}
				}
				break;
			case EVT_MOTION_STOP:
				if (state == STATE_MOVING) {
					LOG_INF("Stationary");
					state = STATE_STATIONARY;
					report(); /* resting position */
					reschedule();
				}
				break;
			case EVT_REPORT_DUE:
				report();
				break;
			}
		}

		task_wdt_feed(wdt_channel);
	}

	return 0;
}
```

## src/cloud.c
```c
/*
 * MQTT 3.1.1 over TLS 1.2 to the IoT broker.
 *
 * Security properties
 *  - Mutual TLS: CA, client certificate and private key live in the modem's
 *    protected credential storage under CONFIG_TRACKER_SEC_TAG; the key is
 *    generated inside the modem and never leaves it.
 *  - Server certificate and hostname are always verified.
 *  - TLS session resumption cuts a reconnect from a ~4 kB full handshake to
 *    a ~0.3 kB abbreviated one: important for both battery and the 1NCE
 *    500 MB / 10 year data allowance.
 *  - Downlink payloads are size-checked and parsed with a typed, heap-free
 *    JSON parser; unknown topics are ignored.
 *
 * Single-threaded by design: all MQTT I/O runs in the caller's thread via
 * process_until(), so there are no races between the state machine and the
 * MQTT event handler.
 */
#include <stdio.h>
#include <string.h>
#include <zephyr/kernel.h>
#include <zephyr/logging/log.h>
#include <zephyr/net/mqtt.h>
#include <zephyr/net/socket.h>
#include <zephyr/data/json.h>
#include <net/nrf_cloud_agnss.h>

#include "cloud.h"

LOG_MODULE_REGISTER(cloud, CONFIG_TRACKER_LOG_LEVEL);

#define TOPIC_PREFIX "pt/v1/"
#define TOPIC_LEN    64

/* A full GPS A-GNSS set (ephemerides + almanac + UTC + iono + time) is
 * ~3.5 kB; anything larger than this buffer is discarded.
 */
#define DOWNLINK_MAX_LEN 4096

static struct mqtt_client client;
static struct net_sockaddr_storage broker;
static bool broker_resolved;

static uint8_t rx_buf[512];
static uint8_t tx_buf[512];
static uint8_t payload_buf[DOWNLINK_MAX_LEN + 1];

static char client_id[TRACKER_DEVICE_ID_LEN];
static char topic_telemetry[TOPIC_LEN];
static char topic_batch[TOPIC_LEN];
static char topic_heartbeat[TOPIC_LEN];
static char topic_agnss_req[TOPIC_LEN];
static char topic_down_filter[TOPIC_LEN];
static char topic_down_agnss[TOPIC_LEN];
static char topic_down_config[TOPIC_LEN];
static char topic_down_fota[TOPIC_LEN];

static const struct cloud_handlers *app_handlers;

static sec_tag_t sec_tags[] = { CONFIG_TRACKER_SEC_TAG };

#if defined(CONFIG_TRACKER_TLS_ECDSA_ONLY)
static const int ciphers[] = {
	0xC02B, /* TLS_ECDHE_ECDSA_WITH_AES_128_GCM_SHA256 */
	0xC023, /* TLS_ECDHE_ECDSA_WITH_AES_128_CBC_SHA256 */
};
#endif

/* Session state, only touched from the caller's thread. */
static bool connected;
static bool connack_received;
static int connack_result;
static bool session_present;
static bool suback_received;
static bool puback_received;
static uint16_t puback_expected_id;
static bool agnss_received;
static uint8_t agnss_parts_expected;
static uint8_t agnss_parts_received;
static uint16_t next_message_id = 1;

static uint16_t message_id_next(void)
{
	if (next_message_id == 0) {
		next_message_id = 1; /* 0 is not a valid packet identifier */
	}
	return next_message_id++;
}

/* ------------------------------------------------------------------------- */
/* Downlink handling                                                         */
/* ------------------------------------------------------------------------- */

/* Home zone: centre in micro-degrees, radius in metres (short keys keep
 * the retained config small).
 */
struct zone_msg {
	int32_t la;
	int32_t lo;
	int32_t r;
};

static const struct json_obj_descr zone_descr[] = {
	JSON_OBJ_DESCR_PRIM(struct zone_msg, la, JSON_TOK_NUMBER),
	JSON_OBJ_DESCR_PRIM(struct zone_msg, lo, JSON_TOK_NUMBER),
	JSON_OBJ_DESCR_PRIM(struct zone_msg, r, JSON_TOK_NUMBER),
};

struct config_msg {
	int32_t interval_s;
	bool lost_mode;
	bool night_mode;
	int32_t night_start_utc_min;
	int32_t night_end_utc_min;
	int32_t night_interval_s;
	struct zone_msg zones[POLICY_MAX_ZONES];
	size_t zones_len;
};

static const struct json_obj_descr config_descr[] = {
	JSON_OBJ_DESCR_PRIM(struct config_msg, interval_s, JSON_TOK_NUMBER),
	JSON_OBJ_DESCR_PRIM(struct config_msg, lost_mode, JSON_TOK_TRUE),
	JSON_OBJ_DESCR_PRIM(struct config_msg, night_mode, JSON_TOK_TRUE),
	JSON_OBJ_DESCR_PRIM(struct config_msg, night_start_utc_min, JSON_TOK_NUMBER),
	JSON_OBJ_DESCR_PRIM(struct config_msg, night_end_utc_min, JSON_TOK_NUMBER),
	JSON_OBJ_DESCR_PRIM(struct config_msg, night_interval_s, JSON_TOK_NUMBER),
	JSON_OBJ_DESCR_OBJ_ARRAY(struct config_msg, zones, POLICY_MAX_ZONES, zones_len,
				 zone_descr, ARRAY_SIZE(zone_descr)),
};

struct fota_msg {
	const char *host;
	const char *path;
};

static const struct json_obj_descr fota_descr[] = {
	JSON_OBJ_DESCR_PRIM(struct fota_msg, host, JSON_TOK_STRING),
	JSON_OBJ_DESCR_PRIM(struct fota_msg, path, JSON_TOK_STRING),
};

static void on_config(char *json, size_t len)
{
	struct config_msg msg = { 0 };
	struct tracker_config cfg = { 0 };
	int64_t fields = json_obj_parse(json, len, config_descr, ARRAY_SIZE(config_descr), &msg);

	if (fields < 0 || !(fields & BIT(0))) {
		LOG_WRN("Rejected malformed config (%lld)", (long long)fields);
		return;
	}

	if (msg.interval_s < 60 || msg.interval_s > 86400) {
		LOG_WRN("Rejected out-of-range interval %d", msg.interval_s);
		return;
	}

	cfg.moving_interval_s = (uint32_t)msg.interval_s;
	cfg.lost_mode = (fields & BIT(1)) ? msg.lost_mode : false;

	/* Night watch is optional; accept it only if the whole window is valid. */
	if ((fields & (BIT(2) | BIT(3) | BIT(4) | BIT(5))) == (BIT(2) | BIT(3) | BIT(4) | BIT(5)) &&
	    msg.night_start_utc_min >= 0 && msg.night_start_utc_min < 1440 &&
	    msg.night_end_utc_min >= 0 && msg.night_end_utc_min < 1440 &&
	    msg.night_interval_s >= 60 && msg.night_interval_s <= 3600) {
		cfg.night_mode = msg.night_mode;
		cfg.night_start_utc_min = (uint16_t)msg.night_start_utc_min;
		cfg.night_end_utc_min = (uint16_t)msg.night_end_utc_min;
		cfg.night_interval_s = (uint32_t)msg.night_interval_s;
	}

	/* Home zones are optional; a malformed one is skipped, not fatal. */
	if (fields & BIT(6)) {
		for (size_t i = 0; i < msg.zones_len && i < POLICY_MAX_ZONES; i++) {
			const struct zone_msg *z = &msg.zones[i];

			if (z->la < -90000000 || z->la > 90000000 || z->lo < -180000000 ||
			    z->lo > 180000000 || z->r < 10 || z->r > 5000) {
				continue;
			}
			cfg.zones[cfg.zone_count++] = (struct policy_zone){
				.lat_e6 = z->la, .lng_e6 = z->lo, .radius_m = (uint16_t)z->r,
			};
		}
	}

	if (app_handlers && app_handlers->config) {
		app_handlers->config(&cfg);
	}
}

static void on_fota(char *json, size_t len)
{
	struct fota_msg msg = { 0 };
	int64_t fields = json_obj_parse(json, len, fota_descr, ARRAY_SIZE(fota_descr), &msg);

	if (fields != (BIT(0) | BIT(1)) || msg.host == NULL || msg.path == NULL) {
		LOG_WRN("Rejected malformed FOTA job");
		return;
	}

	/* Image authenticity is enforced by MCUboot's signature check, not by
	 * trusting this message; the download itself also runs over TLS.
	 */
	if (app_handlers && app_handlers->fota) {
		app_handlers->fota(msg.host, msg.path);
	}
}

static bool topic_is(const struct mqtt_utf8 *topic, const char *expected)
{
	return topic->size == strlen(expected) &&
	       memcmp(topic->utf8, expected, topic->size) == 0;
}

static void on_publish(struct mqtt_client *const c, const struct mqtt_publish_param *p)
{
	const struct mqtt_utf8 *topic = &p->message.topic.topic;
	size_t len = p->message.payload.len;
	int err;

	if (len > DOWNLINK_MAX_LEN) {
		/* Drain and drop: never let a peer overflow our buffers. */
		LOG_WRN("Dropping oversized downlink (%u bytes)", (unsigned int)len);
		while (len > 0) {
			size_t chunk = MIN(len, DOWNLINK_MAX_LEN);

			if (mqtt_readall_publish_payload(c, payload_buf, chunk)) {
				return;
			}
			len -= chunk;
		}
		goto ack;
	}

	err = mqtt_readall_publish_payload(c, payload_buf, len);
	if (err) {
		LOG_ERR("Failed to read payload: %d", err);
		return;
	}
	payload_buf[len] = '\0';

	if (topic_is(topic, topic_down_agnss)) {
		err = nrf_cloud_agnss_process((const char *)payload_buf, len);
		LOG_INF("A-GNSS part injected (%u bytes): %d", (unsigned int)len, err);
		agnss_parts_received++;
		agnss_received = agnss_parts_received >= agnss_parts_expected;
	} else if (topic_is(topic, topic_down_config)) {
		on_config((char *)payload_buf, len);
	} else if (topic_is(topic, topic_down_fota)) {
		on_fota((char *)payload_buf, len);
	} else {
		LOG_WRN("Ignoring downlink on unexpected topic");
	}

ack:
	if (p->message.topic.qos == MQTT_QOS_1_AT_LEAST_ONCE) {
		const struct mqtt_puback_param ack = { .message_id = p->message_id };

		mqtt_publish_qos1_ack(c, &ack);
	}
}

static void mqtt_evt_handler(struct mqtt_client *const c, const struct mqtt_evt *evt)
{
	switch (evt->type) {
	case MQTT_EVT_CONNACK:
		connack_result = evt->result;
		session_present = evt->param.connack.session_present_flag;
		connack_received = true;
		connected = (evt->result == 0);
		break;
	case MQTT_EVT_DISCONNECT:
		connected = false;
		break;
	case MQTT_EVT_PUBACK:
		if (evt->param.puback.message_id == puback_expected_id) {
			puback_received = true;
		}
		break;
	case MQTT_EVT_SUBACK:
		suback_received = true;
		break;
	case MQTT_EVT_PUBLISH:
		on_publish(c, &evt->param.publish);
		break;
	default:
		break;
	}
}

/* ------------------------------------------------------------------------- */
/* Transport                                                                 */
/* ------------------------------------------------------------------------- */

/* Run the MQTT state machine until *flag becomes true or the time is up. */
static int process_until(const bool *flag, int timeout_ms)
{
	int64_t deadline = k_uptime_get() + timeout_ms;

	while (flag == NULL || !*flag) {
		struct zsock_pollfd fds = {
			.fd = client.transport.tls.sock,
			.events = ZSOCK_POLLIN,
		};
		int64_t remaining = deadline - k_uptime_get();
		int ret;

		if (remaining <= 0) {
			return flag ? -ETIMEDOUT : 0;
		}

		ret = zsock_poll(&fds, 1, (int)MIN(remaining, mqtt_keepalive_time_left(&client)));
		if (ret < 0) {
			return -errno;
		}

		if (ret == 0) {
			mqtt_live(&client);
			continue;
		}

		if (fds.revents & ZSOCK_POLLIN) {
			ret = mqtt_input(&client);
			if (ret) {
				return ret;
			}
		}

		if (fds.revents & (ZSOCK_POLLERR | ZSOCK_POLLHUP | ZSOCK_POLLNVAL)) {
			connected = false;
			return -ENOTCONN;
		}

		if (!connected && connack_received) {
			return -ENOTCONN;
		}
	}

	return 0;
}

static int broker_resolve(void)
{
	struct zsock_addrinfo hints = {
		.ai_family = NET_AF_INET,
		.ai_socktype = NET_SOCK_STREAM,
	};
	struct zsock_addrinfo *res;
	int err;

	err = zsock_getaddrinfo(CONFIG_TRACKER_MQTT_BROKER_HOSTNAME, NULL, &hints, &res);
	if (err) {
		LOG_ERR("DNS lookup failed: %d", err);
		return -EHOSTUNREACH;
	}

	struct net_sockaddr_in *b4 = (struct net_sockaddr_in *)&broker;

	b4->sin_family = NET_AF_INET;
	b4->sin_port = net_htons(CONFIG_TRACKER_MQTT_BROKER_PORT);
	b4->sin_addr = ((struct net_sockaddr_in *)res->ai_addr)->sin_addr;
	zsock_freeaddrinfo(res);

	broker_resolved = true;
	return 0;
}

static void client_setup(void)
{
	struct mqtt_sec_config *tls = &client.transport.tls.config;

	mqtt_client_init(&client);

	client.broker = &broker;
	client.evt_cb = mqtt_evt_handler;
	client.client_id.utf8 = (const uint8_t *)client_id;
	client.client_id.size = strlen(client_id);
	client.protocol_version = MQTT_VERSION_3_1_1;
	/* Persistent session: QoS 1 downlinks published while the device is
	 * in PSM are queued by the broker and delivered on the next connect.
	 */
	client.clean_session = 0;
	client.keepalive = CONFIG_TRACKER_MQTT_KEEPALIVE_S;
	client.rx_buf = rx_buf;
	client.rx_buf_size = sizeof(rx_buf);
	client.tx_buf = tx_buf;
	client.tx_buf_size = sizeof(tx_buf);

	client.transport.type = MQTT_TRANSPORT_SECURE;
	tls->peer_verify = ZSOCK_TLS_PEER_VERIFY_REQUIRED;
	tls->sec_tag_list = sec_tags;
	tls->sec_tag_count = ARRAY_SIZE(sec_tags);
	tls->hostname = CONFIG_TRACKER_MQTT_BROKER_HOSTNAME;
	tls->session_cache = ZSOCK_TLS_SESSION_CACHE_ENABLED;
#if defined(CONFIG_TRACKER_TLS_ECDSA_ONLY)
	tls->cipher_list = ciphers;
	tls->cipher_count = ARRAY_SIZE(ciphers);
#endif
}

static int subscribe(void)
{
	struct mqtt_topic topic = {
		.topic = {
			.utf8 = (const uint8_t *)topic_down_filter,
			.size = strlen(topic_down_filter),
		},
		.qos = MQTT_QOS_1_AT_LEAST_ONCE,
	};
	const struct mqtt_subscription_list list = {
		.list = &topic,
		.list_count = 1,
		.message_id = message_id_next(),
	};
	int err;

	suback_received = false;
	err = mqtt_subscribe(&client, &list);
	if (err) {
		return err;
	}

	return process_until(&suback_received, 10 * MSEC_PER_SEC);
}

/* ------------------------------------------------------------------------- */
/* Public API                                                                */
/* ------------------------------------------------------------------------- */

int cloud_init(const char *device_id, const struct cloud_handlers *handlers)
{
	app_handlers = handlers;

	snprintf(client_id, sizeof(client_id), "%s", device_id);
	snprintf(topic_telemetry, TOPIC_LEN, TOPIC_PREFIX "%s/telemetry", device_id);
	snprintf(topic_batch, TOPIC_LEN, TOPIC_PREFIX "%s/telemetry/batch", device_id);
	snprintf(topic_heartbeat, TOPIC_LEN, TOPIC_PREFIX "%s/telemetry/heartbeat", device_id);
	snprintf(topic_agnss_req, TOPIC_LEN, TOPIC_PREFIX "%s/agnss/req", device_id);
	snprintf(topic_down_filter, TOPIC_LEN, TOPIC_PREFIX "%s/down/+", device_id);
	snprintf(topic_down_agnss, TOPIC_LEN, TOPIC_PREFIX "%s/down/agnss", device_id);
	snprintf(topic_down_config, TOPIC_LEN, TOPIC_PREFIX "%s/down/config", device_id);
	snprintf(topic_down_fota, TOPIC_LEN, TOPIC_PREFIX "%s/down/fota", device_id);

	return 0;
}

int cloud_connect(void)
{
	int err;

	if (connected) {
		return 0;
	}

	if (!broker_resolved) {
		err = broker_resolve();
		if (err) {
			return err;
		}
	}

	client_setup();
	connack_received = false;

	err = mqtt_connect(&client);
	if (err) {
		LOG_ERR("mqtt_connect failed: %d", err);
		broker_resolved = false; /* re-resolve next time (IP may have moved) */
		return err;
	}

	err = process_until(&connack_received, 30 * MSEC_PER_SEC);
	if (err || connack_result != 0) {
		LOG_ERR("CONNACK failed: %d / %d", err, connack_result);
		mqtt_abort(&client);
		connected = false;
		return err ? err : -ECONNREFUSED;
	}

	LOG_INF("MQTT connected (session present: %d)", session_present);

	/* The broker remembers subscriptions of a persistent session. */
	if (!session_present) {
		err = subscribe();
		if (err) {
			LOG_WRN("Subscribe failed: %d", err);
		}
	}

	return 0;
}

/* QoS 1 publish; returns after the PUBACK. */
static int publish_qos1(const char *topic, const char *data, size_t len)
{
	const struct mqtt_publish_param param = {
		.message = {
			.topic = {
				.topic = {
					.utf8 = (const uint8_t *)topic,
					.size = strlen(topic),
				},
				.qos = MQTT_QOS_1_AT_LEAST_ONCE,
			},
			.payload = {
				.data = (uint8_t *)data,
				.len = len,
			},
		},
		.message_id = message_id_next(),
	};
	int err;

	puback_received = false;
	puback_expected_id = param.message_id;

	err = mqtt_publish(&client, &param);
	if (err) {
		return err;
	}

	return process_until(&puback_received, 15 * MSEC_PER_SEC);
}

int cloud_publish_fix(const struct tracker_fix *fix)
{
	char json[192];
	int len;

	len = snprintf(json, sizeof(json),
		       "{\"device_id\":\"%s\",\"lat\":%.6f,\"lng\":%.6f,\"batt\":%u,"
		       "\"accuracy\":%.1f,\"ts\":%lld,\"seq\":%u}",
		       client_id, fix->lat, fix->lng, fix->batt_pct,
		       (double)fix->accuracy_m, (long long)fix->ts, fix->seq);
	if (len < 0 || len >= (int)sizeof(json)) {
		return -ENOMEM;
	}

	return publish_qos1(topic_telemetry, json, len);
}

int cloud_publish_fixes(const struct tracker_fix *fixes, size_t n)
{
	/* ~45 bytes per fix as a compact array instead of ~110 as an object:
	 * one message and one PUBACK round trip for the whole group.
	 */
	char json[64 + CLOUD_BATCH_MAX * 64];
	int len;

	if (n == 0 || n > CLOUD_BATCH_MAX) {
		return -EINVAL;
	}

	len = snprintf(json, sizeof(json), "{\"device_id\":\"%s\",\"fixes\":[", client_id);
	for (size_t i = 0; i < n && len > 0 && len < (int)sizeof(json); i++) {
		const struct tracker_fix *f = &fixes[i];

		len += snprintf(json + len, sizeof(json) - len, "%s[%.6f,%.6f,%.1f,%u,%lld,%u]",
				i ? "," : "", f->lat, f->lng, (double)f->accuracy_m, f->batt_pct,
				(long long)f->ts, f->seq);
	}
	if (len > 0 && len < (int)sizeof(json)) {
		len += snprintf(json + len, sizeof(json) - len, "]}");
	}
	if (len < 0 || len >= (int)sizeof(json)) {
		return -ENOMEM;
	}

	return publish_qos1(topic_batch, json, len);
}

int cloud_publish_heartbeat(uint8_t batt_pct, const char *gnss)
{
	char json[96];
	int len = snprintf(json, sizeof(json), "{\"device_id\":\"%s\",\"batt\":%u,\"gnss\":\"%s\"}",
			   client_id, batt_pct, gnss);

	if (len < 0 || len >= (int)sizeof(json)) {
		return -ENOMEM;
	}

	return publish_qos1(topic_heartbeat, json, len);
}

int cloud_agnss_fetch(const struct nrf_modem_gnss_agnss_data_frame *need,
		      const struct modem_cell_info *cell)
{
	char json[160];
	char types[40] = "";
	size_t n = 0;
	int len;
	int err;

	/* Map the modem's request onto nRF Cloud A-GNSS type ids, which the
	 * backend forwards to the assistance-data service. Contract with the
	 * backend: ephemerides (type 2) come back as their own message, all
	 * other types together in a second one.
	 */
#define ADD_TYPE(id) (n += snprintf(&types[n], sizeof(types) - n, "%s%d", n ? "," : "", (id)))
	if (need->data_flags & NRF_MODEM_GNSS_AGNSS_GPS_UTC_REQUEST) {
		ADD_TYPE(1);
	}
	if (need->system_count > 0 && need->system[0].sv_mask_ephe) {
		ADD_TYPE(2);
	}
	if (need->system_count > 0 && need->system[0].sv_mask_alm) {
		ADD_TYPE(3);
	}
	if (need->data_flags & NRF_MODEM_GNSS_AGNSS_KLOBUCHAR_REQUEST) {
		ADD_TYPE(4);
	}
	if (need->data_flags & NRF_MODEM_GNSS_AGNSS_NEQUICK_REQUEST) {
		ADD_TYPE(5);
	}
	if (need->data_flags & NRF_MODEM_GNSS_AGNSS_GPS_SYS_TIME_AND_SV_TOW_REQUEST) {
		ADD_TYPE(6);
		ADD_TYPE(7);
	}
	if (need->data_flags & NRF_MODEM_GNSS_AGNSS_POSITION_REQUEST) {
		ADD_TYPE(8);
	}
	if (need->data_flags & NRF_MODEM_GNSS_AGNSS_INTEGRITY_REQUEST) {
		ADD_TYPE(9);
	}
#undef ADD_TYPE

	if (n == 0) {
		return 0; /* nothing the service can help with */
	}

	{
		bool ephe = need->system_count > 0 && need->system[0].sv_mask_ephe;

		agnss_parts_expected = (ephe ? 1 : 0) + ((strcmp(types, "2") != 0) ? 1 : 0);
		agnss_parts_received = 0;
	}

	len = snprintf(json, sizeof(json),
		       "{\"types\":[%s],\"mcc\":%u,\"mnc\":%u,\"tac\":%u,\"eci\":%u}",
		       types, cell->mcc, cell->mnc, cell->tac, cell->eci);
	if (len < 0 || len >= (int)sizeof(json)) {
		return -ENOMEM;
	}

	err = cloud_connect();
	if (err) {
		return err;
	}

	const struct mqtt_publish_param param = {
		.message = {
			.topic = {
				.topic = {
					.utf8 = (const uint8_t *)topic_agnss_req,
					.size = strlen(topic_agnss_req),
				},
				.qos = MQTT_QOS_0_AT_MOST_ONCE,
			},
			.payload = {
				.data = (uint8_t *)json,
				.len = len,
			},
		},
		.message_id = message_id_next(),
	};

	agnss_received = false;
	err = mqtt_publish(&client, &param);
	if (err) {
		return err;
	}

	return process_until(&agnss_received, CONFIG_TRACKER_AGNSS_WAIT_S * MSEC_PER_SEC);
}

int cloud_poll(int timeout_ms)
{
	if (!connected) {
		return -ENOTCONN;
	}

	return process_until(NULL, timeout_ms);
}

void cloud_radio_release(void)
{
	int rai = RAI_NO_DATA;

	if (!connected) {
		return;
	}

	/* Release Assistance Indication: skip the network's RRC inactivity
	 * timer (typically 5-20 s at ~5-10 mA) and drop to idle/PSM now.
	 */
	if (zsock_setsockopt(client.transport.tls.sock, ZSOCK_SOL_SOCKET, SO_RAI,
			     &rai, sizeof(rai))) {
		LOG_DBG("SO_RAI not applied: %d", errno);
	}
}

void cloud_disconnect(void)
{
	int rai = RAI_LAST;

	if (!connected) {
		return;
	}

	/* The DISCONNECT packet is the last thing we send this cycle. */
	(void)zsock_setsockopt(client.transport.tls.sock, ZSOCK_SOL_SOCKET, SO_RAI,
			       &rai, sizeof(rai));
	(void)mqtt_disconnect(&client, NULL);
	connected = false;
}
```

## src/cloud.h
```c
#ifndef CLOUD_H_
#define CLOUD_H_

#include <nrf_modem_gnss.h>

#include "modem.h"
#include "tracker.h"

struct cloud_handlers {
	void (*config)(const struct tracker_config *cfg);
	void (*fota)(const char *host, const char *path);
};

int cloud_init(const char *device_id, const struct cloud_handlers *handlers);

/* MQTT CONNECT over TLS 1.2 (mutual auth, session resumption). Idempotent. */
int cloud_connect(void);

/* Most fixes in one batch message (pt/v1/<id>/telemetry/batch). */
#define CLOUD_BATCH_MAX 8

/* QoS 1 publish of one fix; returns after PUBACK. */
int cloud_publish_fix(const struct tracker_fix *fix);

/* QoS 1 publish of up to CLOUD_BATCH_MAX consecutive fixes in one message. */
int cloud_publish_fixes(const struct tracker_fix *fixes, size_t n);

/*
 * "Alive, no new position": battery and why there is no fix
 * ("still": hasn't moved, "no_sky", "timeout", "skipped": backing off).
 */
int cloud_publish_heartbeat(uint8_t batt_pct, const char *gnss);

/* Ask the backend for A-GNSS data and inject the answer into the modem. */
int cloud_agnss_fetch(const struct nrf_modem_gnss_agnss_data_frame *need,
		      const struct modem_cell_info *cell);

/* Drain queued downlinks (config, FOTA) for up to timeout_ms. */
int cloud_poll(int timeout_ms);

/* Tell the network no more data is coming so RRC is released immediately. */
void cloud_radio_release(void);

void cloud_disconnect(void);

#endif /* CLOUD_H_ */
```

## src/location.h
```c
#ifndef LOCATION_H_
#define LOCATION_H_

#include <zephyr/kernel.h>
#include <nrf_modem_gnss.h>

#include "tracker.h"

enum location_evt {
	LOCATION_EVT_NONE,
	LOCATION_EVT_FIX,           /* valid fix available: location_fix_get() */
	LOCATION_EVT_TIMEOUT,       /* GNSS gave up after the configured retry time */
	LOCATION_EVT_AGNSS_NEEDED,  /* modem asks for assistance: location_agnss_request() */
	LOCATION_EVT_NO_SKY,        /* searched TRACKER_GNSS_NOSKY_S without usable satellites */
};

int location_init(void);

/* Start a single-shot fix that the modem abandons after timeout_s. */
int location_fix_start(uint16_t timeout_s);

int location_stop(void);

/* A-GNSS was just injected: restart the no-sky clock for this search. */
void location_assistance_injected(void);

/* Wait for the next GNSS event of interest. */
enum location_evt location_wait(k_timeout_t timeout);

void location_fix_get(struct tracker_fix *fix);

/* Latest assistance-data need reported by the modem. */
const struct nrf_modem_gnss_agnss_data_frame *location_agnss_request(void);

#endif /* LOCATION_H_ */
```
